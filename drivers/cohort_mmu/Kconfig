## drivers/cohort_mmu/Kconfig
```kconfig
# SPDX-License-Identifier: GPL-2.0-only
#
# Cohort MMU device configuration
#

config COHORT_MMU
    bool "COHORT MMU"
    default y
    select MMU_NOTIFIER
    ---help---
        Instantiate Cohort MMU device and driver 
```
